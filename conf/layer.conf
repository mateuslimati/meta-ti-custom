## conf/layer.conf
```bitbake
# We have a conf and classes directory, add to BBPATH
BBPATH .= ":${LAYERDIR}"

# We have recipes-* directories, add to BBFILES
BBFILES += "${LAYERDIR}/recipes-*/*/*.bb \
            ${LAYERDIR}/recipes-*/*/*.bbappend"

BBFILE_COLLECTIONS += "meta-ti-custom"
BBFILE_PATTERN_meta-ti-custom = "^${LAYERDIR}/"
BBFILE_PRIORITY_meta-ti-custom = "6"

LAYERDEPENDS_meta-ti-custom = "core"
LAYERSERIES_COMPAT_meta-ti-custom = "kirkstone"
```

## conf/machine/scorpion.conf
```bitbake
#@TYPE: Machine
#@NAME: Scorpion machine
#@DESCRIPTION: Machine configuration for the http://beagleboard.org/bone based board

require conf/machine/include/ti33x.inc

PREFERRED_PROVIDER_virtual/kernel = "linux-bb.org"

KERNEL_DEVICETREE_PREFIX = "am335x-bone"

KERNEL_DEVICETREE = " \
    am335x-boneblack.dtb \
"

SERIAL_CONSOLES = "115200;ttyS0"

# U-boot configs
UBOOT_EXTLINUX_ROOT =  "root=/dev/mmcblk0p2"
UBOOT_EXTLINUX_CONSOLE = "console=ttyS0,115200n8"
```
